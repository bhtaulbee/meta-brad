## conf/layer.conf
```bitbake
BBPATH .= ":${LAYERDIR}"

BBFILES += "${LAYERDIR}/recipes*/*/*.bb \
            ${LAYERDIR}/recipes*/*/*.bbappend \
            "
BBFILE_COLLECTIONS += "brad"
BBFILE_PATTERN_brad := "^${LAYERDIR}/"
BBFILE_PRIORITY_brad = "1"

LAYERSERIES_COMPAT_brad = "walnascar styhead "
```
